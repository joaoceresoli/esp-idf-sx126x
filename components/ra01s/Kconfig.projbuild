## components/ra01s/Kconfig.projbuild
```kconfig
menu "SX126X Configuration"

	config GPIO_RANGE_MAX
		int
		default 33 if IDF_TARGET_ESP32

	config MISO_GPIO
		int "SX126X MISO GPIO"
		range 0 GPIO_RANGE_MAX
		default 19 if IDF_TARGET_ESP32
		help
			Pin Number to be used as the MISO SPI signal.

	config SCLK_GPIO
		int "SX126X SCLK GPIO"
		range 0 GPIO_RANGE_MAX
		default 18 if IDF_TARGET_ESP32
		help
			Pin Number to be used as the SCLK SPI signal.

	config MOSI_GPIO
		int "SX126X MOSI GPIO"
		range 0 GPIO_RANGE_MAX
		default 23 if IDF_TARGET_ESP32
		help
			Pin Number to be used as the MOSI SPI signal.

	config NSS_GPIO
		int "SX126X NSS GPIO"
		range 0 GPIO_RANGE_MAX
		default 05 if IDF_TARGET_ESP32 
		help
			Pin Number to be used as the NSS SPI signal.

	config RST_GPIO
		int "SX126X RST GPIO"
		range 0 GPIO_RANGE_MAX
		default 14 if IDF_TARGET_ESP32
		help
			Pin Number to be used as the RST signal.

	config BUSY_GPIO
		int "SX126X BUSY GPIO"
		range 0 GPIO_RANGE_MAX
		default 26 if IDF_TARGET_ESP32
		help
			Pin Number to be used as the BUSY signal.

	config TXEN_GPIO
		int "SX126X TXEN GPIO"
		range -1 GPIO_RANGE_MAX
		default -1
		help
			Pin Number to be used as the TXEN signal.

	config RXEN_GPIO
		int "SX126X RXEN GPIO"
		range -1 GPIO_RANGE_MAX
		default -1
		help
			Pin Number to be used as the RXEN signal.

	choice SPI_HOST
		prompt "SPI peripheral that controls this bus"
		default SPI2_HOST
		help
			Select SPI peripheral that controls this bus.
		config SPI2_HOST
			bool "SPI2_HOST"
			help
				Use SPI2_HOST. This is also called HSPI_HOST.
		config SPI3_HOST
			bool "SPI3_HOST"
			help
				USE SPI3_HOST. This is also called VSPI_HOST
	endchoice

endmenu
```
